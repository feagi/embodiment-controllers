## embodiments/esp32/firmware/controller/sdkconfig.defaults
```kconfig
# ESP-IDF defaults for FEAGI ESP32 Controller firmware
CONFIG_ESPTOOLPY_FLASHSIZE_4MB=y
CONFIG_PARTITION_TABLE_CUSTOM=y
CONFIG_PARTITION_TABLE_CUSTOM_FILENAME="partitions.csv"
```
